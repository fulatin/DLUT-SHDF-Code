## src/application/course_experiment/Kconfig
```kconfig
#===============================================================================
# @brief    Kconfig file.
# Copyright (c) HiSilicon (Shanghai) Technologies Co., Ltd. 2023-2023. All rights reserved.
#===============================================================================

config ENABLE_EXPERIMENT_1
    bool
    prompt "Enable experiment 1"
    default n
    depends on COURSE_EXPERIMENT_ENABLE
    help
        This enable the suppert for experiment 1

if ENABLE_EXPERIMENT_1
osource "application/course_experiment/experiment1/Kconfig"
endif

config ENABLE_EXPERIMENT_3
    bool
    prompt "Enable experiment 3"
    default n
    depends on COURSE_EXPERIMENT_ENABLE
    help
        This enable the suppert for experiment 3

if ENABLE_EXPERIMENT_3
osource "application/course_experiment/experiment3/Kconfig"
endif
config ENABLE_EXPERIMENT_4
    bool
    prompt "Enable experiment 4"
    default n
    depends on COURSE_EXPERIMENT_ENABLE
    help
        This enable the suppert for experiment 4

if ENABLE_EXPERIMENT_4
osource "application/course_experiment/experiment4/Kconfig"
endif
config ENABLE_EXPERIMENT_5
    bool
    prompt "Enable experiment 5"
    default n
    depends on COURSE_EXPERIMENT_ENABLE
    help
        This enable the suppert for experiment 5

if ENABLE_EXPERIMENT_5
osource "application/course_experiment/experiment5/Kconfig"
endif
config ENABLE_EXPERIMENT_5_1
    bool
    prompt "Enable experiment 5_1"
    default n
    depends on COURSE_EXPERIMENT_ENABLE
    help
        This enable the suppert for experiment 5_1

if ENABLE_EXPERIMENT_5_1
osource "application/course_experiment/experiment5_1/Kconfig"
endif
config ENABLE_EXPERIMENT_6
    bool
    prompt "Enable experiment 6"
    default n
    depends on COURSE_EXPERIMENT_ENABLE
    help
        This enable the suppert for experiment 6

if ENABLE_EXPERIMENT_6
osource "application/course_experiment/experiment6/Kconfig"
endif
```
